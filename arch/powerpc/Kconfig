## arch/powerpc/Kconfig
```kconfig
#
# SPDX-License-Identifier: Apache-2.0
#

menu "PowerPC Options"
	depends on POWERPC

config ARCH
	string
	default "powerpc64" if 64BIT
	default "powerpc32"

menu "PowerPC Processor Options"

endmenu

config USE_SWITCH
	default y

config USE_SWITCH_SUPPORTED
	default y

config NUM_IRQS
	int "Upper limit of interrupt numbers/IDs used"
	range 1 1
	help
	  Interrupts available will be 0 to NUM_IRQS-1.
	  FIXME placeholder for now till we get an IRQ controller


endmenu
```

## boards/powerpc/microwatt/Kconfig.board
```kconfig
# SPDX-License-Identifier: Apache-2.0

config BOARD_MICROWATT
	bool "Microwatt target"
	select 64BIT
```

## boards/powerpc/microwatt/Kconfig.defconfig
```kconfig
# SPDX-License-Identifier: Apache-2.0

if BOARD_MICROWATT

config BUILD_OUTPUT_BIN
        default y

config BOARD
	default "microwatt"

endif
```

## boards/powerpc/microwatt/microwatt_defconfig
```kconfig
# SPDX-License-Identifier: Apache-2.0

CONFIG_POWERPC=y
CONFIG_64BIT=y
CONFIG_CONSOLE=y
CONFIG_PRINTK=y
CONFIG_SERIAL=y
#CONFIG_UART_CONSOLE=y
CONFIG_SYS_CLOCK_TICKS_PER_SEC=1000
CONFIG_SYS_CLOCK_HW_CYCLES_PER_SEC=512000000
CONFIG_STACK_SENTINEL=y
CONFIG_TEST_EXTRA_STACKSIZE=16384
CONFIG_POWERPC_TIMEBASE=y
CONFIG_TIMESLICING=y
CONFIG_TIMESLICE_SIZE=1
CONFIG_TICKLESS_CAPABLE=n
#CONFIG_SPIN_VALIDATE=y
CONFIG_USERSPACE=n
CONFIG_NUM_IRQS=1
CONFIG_GEN_ISR_TABLES=y
CONFIG_GEN_SW_ISR_TABLE=y
CONFIG_GEN_IRQ_VECTOR_TABLE=n
CONFIG_MAIN_STACK_SIZE=16384
CONFIG_IDLE_STACK_SIZE=16384
CONFIG_ISR_STACK_SIZE=16384

CONFIG_TIMER_RANDOM_GENERATOR=y
```

## dts/bindings/serial/microwatt,uart0.yaml
```yaml
# SPDX-License-Identifier: Apache-2.0

title: MICROWATT UART

description: >
    This binding gives a base representation of the MICROWATT UART

compatible: "microwatt,uart0"

include: uart-controller.yaml

properties:
    reg:
        required: true
```
